## devicetree/smdt_a83t_defconfig
```kconfig
CONFIG_ARM=y
CONFIG_ARCH_SUNXI=y
CONFIG_DEFAULT_DEVICE_TREE="sun8i-a83t-smdt-ds083"
CONFIG_SPL=y
CONFIG_MACH_SUN8I_A83T=y
CONFIG_DRAM_CLK=648
CONFIG_DRAM_ZQ=15355
CONFIG_DRAM_ODT_EN=y
CONFIG_MMC_SUNXI_SLOT_EXTRA=2
CONFIG_USB0_VBUS_PIN="AXP0-VBUS-ENABLE"
CONFIG_USB0_VBUS_DET="PG0"
CONFIG_USB0_ID_DET="PH11"
CONFIG_USB1_VBUS_PIN="PH10"
CONFIG_USB2_VBUS_PIN="PE17"
CONFIG_I2C0_ENABLE=y
CONFIG_AXP_GPIO=y
# CONFIG_SYS_MALLOC_CLEAR_ON_INIT is not set
CONFIG_CONSOLE_MUX=y
CONFIG_AXP_DCDC1_VOLT=3300
CONFIG_AXP_DCDC2_VOLT=900
CONFIG_AXP_DCDC3_VOLT=900
CONFIG_AXP_DCDC4_VOLT=900
CONFIG_AXP_DCDC5_VOLT=1520
CONFIG_AXP_DCDC6_VOLT=900
CONFIG_AXP_ALDO3_VOLT=3000
CONFIG_AXP_ELDO1_VOLT=1200
CONFIG_AXP_ELDO2_VOLT=1800
CONFIG_AXP_DLDO1_VOLT=3100
CONFIG_AXP_DLDO3_VOLT=1800
CONFIG_AXP_DLDO4_VOLT=3000
CONFIG_AXP_FLDO2_VOLT=900
CONFIG_USB_EHCI_HCD=y
CONFIG_USB_OHCI_HCD=y
CONFIG_USB_MUSB_HOST=y
CONFIG_USB_HOST_ETHER=y
CONFIG_USB_ETHER_RTL8152=y
```
